#include "shift_register.h"

#include "board_config.h"

static void ShiftRegister_Pulse(GPIO_RegDef_t *GPIOx, uint8_t pinNumber) {
  GPIO_SetPin(GPIOx, pinNumber);
  GPIO_ResetPin(GPIOx, pinNumber);
}

void ShiftRegister_Init(void) {
  RCC_EnableGPIO(SHIFT_REGISTER_GPIO);

  GPIO_SetPinMode(SHIFT_REGISTER_GPIO, SHIFT_REGISTER_DATA_PIN, OUTPUT);
  GPIO_SetPinMode(SHIFT_REGISTER_GPIO, SHIFT_REGISTER_CLOCK_PIN, OUTPUT);
  GPIO_SetPinMode(SHIFT_REGISTER_GPIO, SHIFT_REGISTER_LATCH_PIN, OUTPUT);
  GPIO_SetPinMode(SHIFT_REGISTER_GPIO, SHIFT_REGISTER_OUTPUT_ENABLE_PIN, OUTPUT);

  GPIO_SetPinPull(SHIFT_REGISTER_GPIO, SHIFT_REGISTER_DATA_PIN, NO_PUDR);
  GPIO_SetPinPull(SHIFT_REGISTER_GPIO, SHIFT_REGISTER_CLOCK_PIN, NO_PUDR);
  GPIO_SetPinPull(SHIFT_REGISTER_GPIO, SHIFT_REGISTER_LATCH_PIN, NO_PUDR);
  GPIO_SetPinPull(SHIFT_REGISTER_GPIO, SHIFT_REGISTER_OUTPUT_ENABLE_PIN, NO_PUDR);

  GPIO_SetPinOutputType(SHIFT_REGISTER_GPIO, SHIFT_REGISTER_DATA_PIN, PUSH_PULL);
  GPIO_SetPinOutputType(SHIFT_REGISTER_GPIO, SHIFT_REGISTER_CLOCK_PIN, PUSH_PULL);
  GPIO_SetPinOutputType(SHIFT_REGISTER_GPIO, SHIFT_REGISTER_LATCH_PIN, PUSH_PULL);
  GPIO_SetPinOutputType(SHIFT_REGISTER_GPIO, SHIFT_REGISTER_OUTPUT_ENABLE_PIN,
                        PUSH_PULL);

  GPIO_SetPinSpeed(SHIFT_REGISTER_GPIO, SHIFT_REGISTER_DATA_PIN, LOW_SPEED);
  GPIO_SetPinSpeed(SHIFT_REGISTER_GPIO, SHIFT_REGISTER_CLOCK_PIN, LOW_SPEED);
  GPIO_SetPinSpeed(SHIFT_REGISTER_GPIO, SHIFT_REGISTER_LATCH_PIN, LOW_SPEED);
  GPIO_SetPinSpeed(SHIFT_REGISTER_GPIO, SHIFT_REGISTER_OUTPUT_ENABLE_PIN,
                   LOW_SPEED);

  GPIO_ResetPin(SHIFT_REGISTER_GPIO, SHIFT_REGISTER_DATA_PIN);
  GPIO_ResetPin(SHIFT_REGISTER_GPIO, SHIFT_REGISTER_CLOCK_PIN);
  GPIO_ResetPin(SHIFT_REGISTER_GPIO, SHIFT_REGISTER_LATCH_PIN);
  GPIO_ResetPin(SHIFT_REGISTER_GPIO, SHIFT_REGISTER_OUTPUT_ENABLE_PIN);
}

void ShiftRegister_OutputEnablePwm_Init(uint8_t brightness) {
  RCC_EnableGPIO(SHIFT_REGISTER_GPIO);
  RCC->APB1ENR |= (1U << 1);
  (void)RCC->APB1ENR;

  GPIO_SetPinMode(SHIFT_REGISTER_GPIO, SHIFT_REGISTER_OUTPUT_ENABLE_PIN, ALT);
  GPIO_SetPinPull(SHIFT_REGISTER_GPIO, SHIFT_REGISTER_OUTPUT_ENABLE_PIN, NO_PUDR);
  GPIO_SetPinOutputType(SHIFT_REGISTER_GPIO, SHIFT_REGISTER_OUTPUT_ENABLE_PIN,
                        PUSH_PULL);
  GPIO_SetPinSpeed(SHIFT_REGISTER_GPIO, SHIFT_REGISTER_OUTPUT_ENABLE_PIN,
                   LOW_SPEED);
  GPIO_SetPinAlternateFunction(SHIFT_REGISTER_GPIO,
                               SHIFT_REGISTER_OUTPUT_ENABLE_PIN, GPIO_AF_TIM3);

  TIM3->CR1 = 0U;
  TIM3->PSC = 79U;
  TIM3->ARR = 99U;
  TIM3->CCR1 = brightness;
  TIM3->CCMR1 &= ~(0xFFUL);
  TIM3->CCMR1 |= (6UL << 4) | (1UL << 3);
  TIM3->CCER &= ~(0xFUL);
  TIM3->CCER |= (1UL << 1) | (1UL << 0);
  TIM3->EGR = 1U;
  TIM3->CR1 |= (1UL << 7) | (1UL << 0);
}

void ShiftRegister_SetBrightness(uint8_t brightness) {
  if (brightness > PWM_MAX_DUTY) {
    brightness = PWM_MAX_DUTY;
  }
  TIM3->CCR1 = brightness;
}

void ShiftRegister_WriteBoards(uint8_t board1Mask, uint8_t board2Mask) {
  GPIO_ResetPin(SHIFT_REGISTER_GPIO, SHIFT_REGISTER_LATCH_PIN);

  for (int8_t bit = 7; bit >= 0; --bit) {
    GPIO_WritePin(SHIFT_REGISTER_GPIO, SHIFT_REGISTER_DATA_PIN,
                  ((board2Mask >> bit) & 0x1U) ? ON : OFF);
    ShiftRegister_Pulse(SHIFT_REGISTER_GPIO, SHIFT_REGISTER_CLOCK_PIN);
  }

  for (int8_t bit = 7; bit >= 0; --bit) {
    GPIO_WritePin(SHIFT_REGISTER_GPIO, SHIFT_REGISTER_DATA_PIN,
                  ((board1Mask >> bit) & 0x1U) ? ON : OFF);
    ShiftRegister_Pulse(SHIFT_REGISTER_GPIO, SHIFT_REGISTER_CLOCK_PIN);
  }

  ShiftRegister_Pulse(SHIFT_REGISTER_GPIO, SHIFT_REGISTER_LATCH_PIN);
}
